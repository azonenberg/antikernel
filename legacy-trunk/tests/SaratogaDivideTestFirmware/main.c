/***********************************************************************************************************************
*                                                                                                                      *
* ANTIKERNEL v0.1                                                                                                      *
*                                                                                                                      *
* Copyright (c) 2012-2016 Andrew D. Zonenberg                                                                          *
* All rights reserved.                                                                                                 *
*                                                                                                                      *
* Redistribution and use in source and binary forms, with or without modification, are permitted provided that the     *
* following conditions are met:                                                                                        *
*                                                                                                                      *
*    * Redistributions of source code must retain the above copyright notice, this list of conditions, and the         *
*      following disclaimer.                                                                                           *
*                                                                                                                      *
*    * Redistributions in binary form must reproduce the above copyright notice, this list of conditions and the       *
*      following disclaimer in the documentation and/or other materials provided with the distribution.                *
*                                                                                                                      *
*    * Neither the name of the author nor the names of any contributors may be used to endorse or promote products     *
*      derived from this software without specific prior written permission.                                           *
*                                                                                                                      *
* THIS SOFTWARE IS PROVIDED BY THE AUTHORS "AS IS" AND ANY EXPRESS OR IMPLIED WARRANTIES, INCLUDING, BUT NOT LIMITED   *
* TO, THE IMPLIED WARRANTIES OF MERCHANTABILITY AND FITNESS FOR A PARTICULAR PURPOSE ARE DISCLAIMED. IN NO EVENT SHALL *
* THE AUTHORS BE HELD LIABLE FOR ANY DIRECT, INDIRECT, INCIDENTAL, SPECIAL, EXEMPLARY, OR CONSEQUENTIAL DAMAGES        *
* (INCLUDING, BUT NOT LIMITED TO, PROCUREMENT OF SUBSTITUTE GOODS OR SERVICES; LOSS OF USE, DATA, OR PROFITS; OR       *
* BUSINESS INTERRUPTION) HOWEVER CAUSED AND ON ANY THEORY OF LIABILITY, WHETHER IN CONTRACT, STRICT LIABILITY, OR TORT *
* (INCLUDING NEGLIGENCE OR OTHERWISE) ARISING IN ANY WAY OUT OF THE USE OF THIS SOFTWARE, EVEN IF ADVISED OF THE       *
* POSSIBILITY OF SUCH DAMAGE.                                                                                          *
*                                                                                                                      *
***********************************************************************************************************************/

/**
	@file
	@author Andrew D. Zonenberg
	@brief SARATOGA integer division test
 */

#include <saratoga/saratoga.h>
#include <rpc.h>
#include <NOCNameServer_constants.h>

int main()
{
	//Set up the interrupt queue
	InterruptQueueInit();
	
	//Signature for nameserver registration (generated by namesign utility)
	unsigned int hostname[] = { 0x64697669, 0x64656677 }; //"dividefw"
	unsigned int signature[] = 
	{ 0xef73693b, 0x1006f2e6, 0xc89002eb, 0x8d28ab53, 0x04be5594, 0x74c1cdc2, 0x8a115e1e, 0x3cf52f3b };

	//Register us with the name server
	//Now using separate library function for this
	if(0 != RegisterHost(hostname, signature))
		return -1;
	
	//Loop forever waiting for a message to show up, then echo it back
	RPCMessage_t msg;
	while(1)
	{
		RecvRPCMessage(&msg);
		
		DebugTracePoint();
		
		msg.to = msg.from;
		msg.from = 0;
		
		//drop anything but a call, if it's a call compute the quotient and remainder and return success
		if(msg.type == RPC_TYPE_CALL)
		{
			int a = msg.data[1];
			int b = msg.data[2];
			
			msg.data[1] = a / b;
			msg.data[2] = a % b;
			
			msg.type = RPC_TYPE_RETURN_SUCCESS;
			SendRPCMessage(&msg);
		}
	}
	
	return 0;
}

