/***********************************************************************************************************************
*                                                                                                                      *
* ANTIKERNEL v0.1                                                                                                      *
*                                                                                                                      *
* Copyright (c) 2012-2016 Andrew D. Zonenberg                                                                          *
* All rights reserved.                                                                                                 *
*                                                                                                                      *
* Redistribution and use in source and binary forms, with or without modification, are permitted provided that the     *
* following conditions are met:                                                                                        *
*                                                                                                                      *
*    * Redistributions of source code must retain the above copyright notice, this list of conditions, and the         *
*      following disclaimer.                                                                                           *
*                                                                                                                      *
*    * Redistributions in binary form must reproduce the above copyright notice, this list of conditions and the       *
*      following disclaimer in the documentation and/or other materials provided with the distribution.                *
*                                                                                                                      *
*    * Neither the name of the author nor the names of any contributors may be used to endorse or promote products     *
*      derived from this software without specific prior written permission.                                           *
*                                                                                                                      *
* THIS SOFTWARE IS PROVIDED BY THE AUTHORS "AS IS" AND ANY EXPRESS OR IMPLIED WARRANTIES, INCLUDING, BUT NOT LIMITED   *
* TO, THE IMPLIED WARRANTIES OF MERCHANTABILITY AND FITNESS FOR A PARTICULAR PURPOSE ARE DISCLAIMED. IN NO EVENT SHALL *
* THE AUTHORS BE HELD LIABLE FOR ANY DIRECT, INDIRECT, INCIDENTAL, SPECIAL, EXEMPLARY, OR CONSEQUENTIAL DAMAGES        *
* (INCLUDING, BUT NOT LIMITED TO, PROCUREMENT OF SUBSTITUTE GOODS OR SERVICES; LOSS OF USE, DATA, OR PROFITS; OR       *
* BUSINESS INTERRUPTION) HOWEVER CAUSED AND ON ANY THEORY OF LIABILITY, WHETHER IN CONTRACT, STRICT LIABILITY, OR TORT *
* (INCLUDING NEGLIGENCE OR OTHERWISE) ARISING IN ANY WAY OUT OF THE USE OF THIS SOFTWARE, EVEN IF ADVISED OF THE       *
* POSSIBILITY OF SUCH DAMAGE.                                                                                          *
*                                                                                                                      *
***********************************************************************************************************************/

/**
	@file
	@author Andrew D. Zonenberg
	@brief Implementation of WaveformView
 */

#include "tdrview.h"
#include "WaveformView.h"
#include "MainWindow.h"
#include "../scopehal/scopehal.h"

#define HEIGHT 768

////////////////////////////////////////////////////////////////////////////////////////////////////////////////////////
// Construction / destruction
WaveformView::WaveformView(MainWindow* parent)
	: m_parent(parent)
{
	add_events(
		Gdk::EXPOSURE_MASK |
		Gdk::BUTTON_PRESS_MASK |
		Gdk::BUTTON_RELEASE_MASK |
		Gdk::POINTER_MOTION_MASK);
		
	//Allocate our pixel array
	m_pixels = new RGBTRIPLE[NUM_SAMPLES * HEIGHT];
	
	set_size(NUM_SAMPLES,HEIGHT);
	
	m_cursors[0] = 0;
	m_cursors[1] = 0;
	m_mousedown = false;
}

WaveformView::~WaveformView()
{
	delete[] m_pixels;
}

////////////////////////////////////////////////////////////////////////////////////////////////////////////////////////
// Rendering

bool WaveformView::on_draw(const Cairo::RefPtr<Cairo::Context>& cr)
{
	Glib::RefPtr<Gdk::Window> window = get_bin_window();
	if(window)
	{	
		//printf("========== NEW FRAME ==========\n");
		
		//Get dimensions of the virtual canvas (max of requested size and window size)
		/*
		Gtk::Allocation allocation = get_allocation();
		int width = allocation.get_width();
		int height = allocation.get_height();
		if(m_width > width)
			width = m_width;
		if(m_height > height)
			m_height = height;
		*/
		
		//Get the visible area of the window
		unsigned int pwidth = get_width();
		unsigned int pheight = get_height();
	
		//Set up drawing context
		cr->save();
		cr->set_identity_matrix();
		
		//Fill background
		cr->set_source_rgb(0, 0, 0);
		cr->rectangle(0, 0, NUM_SAMPLES, pheight);
		cr->fill();
		
		//Create the bitmap
		m_parent->m_bufmutex.lock();
			#pragma omp parallel for
			//for(int y=0; y<DAC_BINS; y++)
			for(unsigned  y=1664; y<2432; y++)
			{
				//TMP: 4x zoom
				//TODO: Invert the weird vertical flip
				for(unsigned  x=0; x<NUM_SAMPLES; x++)
					m_pixels[(y-1664)*NUM_SAMPLES + x] = TransferFunction(
						m_parent->m_normsamples[x][y]);
			}
		m_parent->m_bufmutex.unlock();
		
		//Create the pixbuf
		Glib::RefPtr< Gdk::Pixbuf > pixbuf = Gdk::Pixbuf::create_from_data(
			reinterpret_cast<unsigned char*>(&m_pixels[0]), 
			Gdk::COLORSPACE_RGB,
			false,
			8,
			NUM_SAMPLES,
			HEIGHT,
			NUM_SAMPLES * 3);
			
		//Make a surface and grab a context from it
		Cairo::RefPtr< Cairo::ImageSurface > surface =
			Cairo::ImageSurface::create(Cairo::FORMAT_RGB24, NUM_SAMPLES, HEIGHT);
		Cairo::RefPtr< Cairo::Context > context = Cairo::Context::create(surface);
		Gdk::Cairo::set_source_pixbuf(context, pixbuf, 0.0, 0.0);
		context->paint();
		
		const unsigned int timescale_height = 24;
		
		//Draw the final image
		cr->save();
			cr->set_source(surface, 0.0, 0.0);
			cr->translate(0, timescale_height);
			cr->rectangle(0, 0, NUM_SAMPLES, HEIGHT);
			cr->clip();
			cr->paint();
		cr->restore();
		
		//Draw the time scale
		Gdk::Color color("white");
		cr->set_source_rgb(color.get_red_p(), color.get_green_p(), color.get_blue_p());
		
		//Draw top line
		cr->move_to(0, 0);
		cr->line_to(pwidth, 0);
		cr->stroke();
		
		//TODO: allow adjusting this
		//Note, this is RTT delay, not one way.
		const float ns_per_meter = 10;
		
		//Draw a line every 100 samples
		//For now, hard code 1 sample per pixel
		const unsigned int minor_line = 10;
		const unsigned int major_line = 20;
		const unsigned int minor_grad = 20;
		const unsigned int major_grad = minor_grad*5;
		for(unsigned int x=0; x<NUM_SAMPLES; x+= minor_grad)
		{
			bool major = ((x % major_grad) == 0);
			int y = major ? major_line : minor_line;
			
			cr->move_to(x, 0);
			cr->line_to(x, y);
			cr->stroke();
			
			//Draw the text
			if(major)
			{
				float t = (x*m_parent->m_samplePeriod) / 1000.0f;
				char namebuf[128];
				snprintf(namebuf, sizeof(namebuf), "%.1f ns", t);
				DrawString(x + 5, 10, cr, namebuf, false);
			}
		}
		
		//Draw the cursors
		for(int i=0; i<2; i++)
		{
			if(i == 0)
				cr->set_source_rgb(1, 1, 0);
			else
				cr->set_source_rgb(0, 1, 1);
			
			//Cursor itself
			float x = m_cursors[i] / m_parent->m_samplePeriod;
			cr->move_to(x, 0);
			cr->line_to(x, HEIGHT);
			cr->stroke();
			
			float delta = (m_cursors[1] - m_cursors[0]) / 1000.0f;
			
			//Format text
			char tbuf[128];
			float t = m_cursors[i] / 1000.0f;
			if(i == 0)
				snprintf(tbuf, sizeof(tbuf), "%.1f ns / %.2f m", t, t/ns_per_meter);
			else
			{
				snprintf(tbuf, sizeof(tbuf), "%.1f ns / %.2f m\n\u0394 = %.1f ns / %.2f m",
					t, t/ns_per_meter,
					delta, delta/ns_per_meter);
			}
			int swidth = 0, sheight = 0;
			GetStringWidth(cr, tbuf, true, swidth, sheight);
			
			//Outline box for the text
			int ybase = 25;
			int margin = 3;
			cr->move_to(x,						ybase);
			cr->line_to(x, 						ybase + sheight + 2*margin);
			cr->line_to(x + swidth + 2*margin,	ybase + sheight + 2*margin);
			cr->line_to(x + swidth + 2*margin,	ybase);
			cr->line_to(x,						ybase);
			cr->fill();
			
			//Text itself
			cr->set_source_rgb(0, 0, 0);
			DrawString(x+margin, ybase+margin, cr, tbuf, false);
		}
		
		//TODO: Draw the grid
		
		//Done			
		cr->restore();
	}
	
	return true;
}

bool WaveformView::on_button_press_event(GdkEventButton* event)
{
	//only want left button
	if(event->button != 1)
		return true;
	
	m_mousedown = true;
		
	m_cursors[0] = m_parent->m_samplePeriod * event->x;
	
	return true;
}

bool WaveformView::on_button_release_event(GdkEventButton* event)
{
	//only want left button
	if(event->button != 1)
		return true;
	
	m_mousedown = false;
	
	m_cursors[1] = m_parent->m_samplePeriod * event->x;
	
	return true;
}

bool WaveformView::on_motion_notify_event(GdkEventMotion* event)
{
	//ignore motion if not dragging
	if(!m_mousedown)
		return true;
		
	m_cursors[1] = m_parent->m_samplePeriod * event->x;
	queue_draw();
		
	return true;
}

//normalized float 0-1
RGBTRIPLE WaveformView::TransferFunction(float f)
{
	//Convert to 0-255
	int i = f * 255;
	if(i < 0)
		i = 0;
	if(i > 255)
		i = 255;
		
	//derived from GIMP "skyline" palette
	static const RGBTRIPLE table[256]=
	{
		{0x04,0x02,0x13},{0x08,0x05,0x2b},{0x0b,0x06,0x38},{0x0d,0x08,0x43},
		{0x0e,0x09,0x4b},{0x11,0x09,0x53},{0x11,0x0b,0x59},{0x12,0x0b,0x60},
		{0x14,0x0c,0x65},{0x14,0x0c,0x6a},{0x16,0x0d,0x6f},{0x16,0x0e,0x72},
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		{0xf6,0xbe,0x1d},{0xf5,0xc2,0x20},{0xf5,0xc7,0x23},{0xf4,0xcb,0x26}
	};
	
	return table[i];
}
